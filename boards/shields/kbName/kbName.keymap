#include <behaviors.dtsi>
#include <dt-bindings/zmk/keys.h>
#include <behaviors/morse.dtsi> // include for the morse reference


/ {  
    keymap {
        compatible = "zmk,keymap";

        base_layer {
            display-name = "Base";
            bindings = < &morse    &kp A    &kp E    &kp T   &kp SPACE >;
        };
    };
 };
